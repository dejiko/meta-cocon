## coconport-experimental/netwalker/conf/machine/netwalker.conf
```bitbake
#@TYPE: Machine
#@NAME: NetWalker
#@DESCRIPTION: 

include conf/machine/include/imx-base.inc
include conf/machine/include/tune-cortexa8.inc

SOC_FAMILY = "mx5:mx51"

KERNEL_DEVICETREE = "imx51-sharp-netwalker.dtb"

#UBOOT_MACHINE = "mx51evk_config"

PREFERRED_PROVIDER_virtual/kernel = "linux-netwalker"
```

## coconport-experimental/q8/conf/machine/q8.conf
```bitbake
#@TYPE: Machine
#@NAME: Q8 Tablet
#@DESCRIPTION: 

require conf/machine/include/sun5i.inc

KERNEL_DEVICETREE = "sun5i-a13-q8-tablet.dtb"
UBOOT_MACHINE = "q8_a13_tablet_defconfig"
SUNXI_FEX_FILE = "sys_config/a13/pov_tab_p703.fex"

PREFERRED_VERSION_linux="4.4.6"

# TODO : move to local.conf
#PREFERRED_PROVIDER_u-boot="u-boot-sunxi"
#PREFERRED_PROVIDER_virtual/bootloader="u-boot-sunxi"
PREFERRED_PROVIDER_virtual/kernel="linux"
```

## conf/distro/opencocon.conf
```bitbake
#-----------------------------------------------------------------------------
#@TYPE: Distribution
#@NAME: opencocon
#@DESCRIPTION: Linux distribution for old computer
#
#@COMMENT: www.opencocon.org
#-----------------------------------------------------------------------------

#TCLIBC = "${OPENCOCON_LIBC}"
#TCMODE = "default"

CACHE = "${TMPDIR}/cache/${TCMODE}-${TCLIBC}${@['', '/' + str(d.getVar('MACHINE', True))][bool(d.getVar('MACHINE', True))]}${@['', '/' + str(d.getVar('SDKMACHINE', True))][bool(d.getVar('SDKMACHINE', True))]}"


#
# Header
#
DISTRO_NAME = "opencocon"
DISTRO_VERSION = "v11"

DISTRO_TYPE = "release"
#DISTRO_TYPE = "debug"

# Put links to sources in deploy/sources to make it easier for people to be GPL compliant
#INHERIT += "src_distribute_local"
SRC_DIST_LOCAL ?= "symlink"


# increase inode/block ratio for ext2 filesystem
#EXTRA_IMAGECMD_ext2 = "-i 8192"

PREFERRED_PROVIDER_hotplug  = "udev"

# KERNEL
PREFERRED_VERSION_linux-libc-headers = "${LINUX_LIBC_HEADERS_VERSION}"
PREFERRED_VERSION_nativesdk-linux-libc-headers = "${LINUX_LIBC_HEADERS_VERSION}"

# uClibc Setting
#LIBC = "${OPENCOCON_LIBC}"
#PREFERRED_PROVIDER_virtual/libc = "${OPENCOCON_LIBC}"
#TARGET_LINK_HASH_STYLE = "-Wl,--hash-style=gnu"

# Busybox Setting
IMAGE_LOGIN_MANAGER = "busybox"
IMAGE_INIT_MANAGER = "busybox"
IMAGE_DEV_MANAGER = "udev"

PREFERRED_PROVIDER_virtual/libx11 = "libx11"
PREFERRED_PROVIDER_jpeg-native = "libjpeg-turbo-native"
PREFERRED_PROVIDER_jpeg = "libjpeg-turbo"
PREFERRED_PROVIDER_make-native = "make-native"
PREFERRED_PROVIDER_virtual/update-alternatives = "opkg-utils"

# FEATURE SELECTION
# We want images supporting the following features (for task-base)
DISTRO_FEATURES = "nfs ipv4 ipv6 wifi alsa ext2 vfat pcmcia usbhost pci largefile nls xattr x11 argp udev opengl ${DISTRO_FEATURES_LIBC_DEFAULT} libc-utmp libc-utmpx sysvinit"
```

## conf/layer.conf
```bitbake
# We have a conf and classes directory, append to BBPATH
BBPATH .= ":${LAYERDIR}"

# We have a recipes directory, add to BBFILES
BBFILES += "${LAYERDIR}/recipes*/*/*.bb ${LAYERDIR}/recipes*/*/*.bbappend"

BBFILE_COLLECTIONS += "cocon"
BBFILE_PATTERN_cocon := "^${LAYERDIR}/"
BBFILE_PRIORITY_cocon = "7"
LAYERSERIES_COMPAT_cocon = "warrior"
```

## feature/meta-caravan-support/conf/layer.conf
```bitbake
# We have a conf and classes directory, add to BBPATH
BBPATH =. "${LAYERDIR}:"

# We have recipes-* directories, add to BBFILES
BBFILES += "${LAYERDIR}/recipes-*/*/*.bb \
            ${LAYERDIR}/recipes-*/*/*.bbappend"

BBFILE_COLLECTIONS += "cocon-caravan"
BBFILE_PATTERN_cocon-caravan = "^${LAYERDIR}/"
BBFILE_PRIORITY_cocon-caravan = "26"
LAYERSERIES_COMPAT_cocon-caravan = "warrior"
```

## feature/meta-thinclient-support/conf/layer.conf
```bitbake
# We have a conf and classes directory, add to BBPATH
BBPATH =. "${LAYERDIR}:"

# We have recipes-* directories, add to BBFILES
BBFILES += "${LAYERDIR}/recipes-*/*/*.bb \
            ${LAYERDIR}/recipes-*/*/*.bbappend"

BBFILE_COLLECTIONS += "cocon-thinclient"
BBFILE_PATTERN_cocon-thinclient = "^${LAYERDIR}/"
BBFILE_PRIORITY_cocon-thinclient = "26"
LAYERSERIES_COMPAT_cocon-thinclient = "warrior"
```

## feature/meta-vpn-support/conf/layer.conf
```bitbake
# We have a conf and classes directory, add to BBPATH
BBPATH =. "${LAYERDIR}:"

# We have recipes-* directories, add to BBFILES
BBFILES += "${LAYERDIR}/recipes-*/*/*.bb \
            ${LAYERDIR}/recipes-*/*/*.bbappend"

BBFILE_COLLECTIONS += "cocon-vpn"
BBFILE_PATTERN_cocon-vpn = "^${LAYERDIR}/"
BBFILE_PRIORITY_cocon-vpn = "26"
LAYERSERIES_COMPAT_cocon-vpn = "warrior"
```

## meta-cocon/conf/distro/opencocon.conf
```bitbake
#-----------------------------------------------------------------------------
#@TYPE: Distribution
#@NAME: opencocon
#@DESCRIPTION: Linux distribution for old computer
#
#@COMMENT: www.opencocon.org
#-----------------------------------------------------------------------------

TCLIBC = "${OPENCOCON_LIBC}"
TCMODE = "default"

CACHE = "${TMPDIR}/cache/${TCMODE}-${TCLIBC}${@['', '/' + str(d.getVar('MACHINE', True))][bool(d.getVar('MACHINE', True))]}${@['', '/' + str(d.getVar('SDKMACHINE', True))][bool(d.getVar('SDKMACHINE', True))]}"


#
# Header
#
DISTRO_NAME = "opencocon"
DISTRO_VERSION = "v10"

DISTRO_TYPE = "release"
#DISTRO_TYPE = "debug"

# Put links to sources in deploy/sources to make it easier for people to be GPL compliant
#INHERIT += "src_distribute_local"
SRC_DIST_LOCAL ?= "symlink"


# increase inode/block ratio for ext2 filesystem
#EXTRA_IMAGECMD_ext2 = "-i 8192"

PREFERRED_PROVIDER_hotplug  = "udev"

# KERNEL
PREFERRED_VERSION_linux-libc-headers = "${LINUX_LIBC_HEADERS_VERSION}"
PREFERRED_VERSION_nativesdk-linux-libc-headers = "${LINUX_LIBC_HEADERS_VERSION}"

# uClibc Setting
LIBC = "${OPENCOCON_LIBC}"
PREFERRED_PROVIDER_virtual/libc = "${OPENCOCON_LIBC}"
#TARGET_LINK_HASH_STYLE = "-Wl,--hash-style=gnu"

# Busybox Setting
IMAGE_LOGIN_MANAGER = "busybox"
IMAGE_INIT_MANAGER = "busybox"
IMAGE_DEV_MANAGER = "udev"

PREFERRED_PROVIDER_virtual/libx11 = "libx11"
PREFERRED_PROVIDER_jpeg-native = "libjpeg-turbo-native"
PREFERRED_PROVIDER_jpeg = "libjpeg-turbo"
PREFERRED_PROVIDER_make-native = "make-native"
PREFERRED_PROVIDER_virtual/update-alternatives = "opkg-utils"

# FEATURE SELECTION
# We want images supporting the following features (for task-base)
DISTRO_FEATURES = "nfs ipv4 ipv6 wifi alsa ext2 vfat pcmcia usbhost pci largefile nls xattr x11 argp udev opengl ${DISTRO_FEATURES_LIBC_DEFAULT} libc-utmp libc-utmpx pulseaudio"

# opencocon v10 (jethro based) local
PREFERRED_VERSION_xf86-video-nouveau = "1.0.12"
PREFERRED_VERSION_elfutils = "0.164"
## force use GTK+2 Version
PREFERRED_VERSION_network-manager-applet = "0.9.8.10"
## for firefox
PREFERRED_VERSION_nspr = "4.10.10"
PREFERRED_VERSION_nspr-native = "4.10.10"
## for x2goclient
#PREFERRED_VERSION_libssh = "0.6.5+gitAUTOINC+6e0dee7845"
```

## meta-coconport/ac100/conf/machine/ac100.conf
```bitbake
#@TYPE: Machine
#@NAME: ac100
#@DESCRIPTION: Toshiba ac100 netbook

require conf/machine/include/tune-cortexa9.inc

TARGET_ARCH = "arm"
DEFAULTTUNE_ac100 = "cortexa9hf"
TUNE_FEATURE_ac100 = "armv7a vfp"

PREFERRED_PROVIDER_virtual/xserver = "xserver-xorg"
XSERVER = "xserver-xorg \
           xf86-input-evdev \
           xf86-input-mouse \
           xf86-video-fbdev \
           xf86-input-keyboard"

# Only has DVI connector for external screen
GUI_MACHINE_CLASS = "bigscreen"

PREFERRED_PROVIDER_virtual/kernel = "linux-tegra"

LINUX_LIBC_HEADERS_VERSION ?= "3.18.26"
PREFERRED_VERSION_linux-libc-headers = "${LINUX_LIBC_HEADERS_VERSION}"
PREFERRED_VERSION_linux-libc-headers-native = "${LINUX_LIBC_HEADERS_VERSION}"
PREFERRED_VERSION_linux-libc-headers-nativesdk = "${LINUX_LIBC_HEADERS_VERSION}"
PREFERRED_VERSION_linux-tegra = "${LINUX_LIBC_HEADERS_VERSION}"

KERNEL_IMAGETYPE = "zImage"

MACHINE_EXTRA_RRECOMMENDS = " kernel-modules"


# and sdio
MACHINE_FEATURES = "kernel26 screen apm usbgadget usbhost vfat alsa usbhost ext2 ipv4 ipv6 wifi largefile nls xattr x11 argp udev sdio opengl cortexa9"
```

## meta-coconport/cocon486/conf/machine/cocon486.conf
```bitbake
# Copyright (C) 2007, Stelios Koroneos - Digital OPSiS, All Rights Reserved
# Released under the MIT license (see packages/COPYING)
#@TYPE: Machine
#@NAME: COCON486
#@DESCRIPTION: Machine configuration for a Linux running on x86 compatible machines

require conf/machine/include/tune-x86.inc

TARGET_ARCH = "i486"
TUNE_ARCH = "i486"

PREFERRED_PROVIDER_virtual/kernel = "linux-cocon486"
PREFERRED_PROVIDER_virtual/xserver = "xserver-xorg"

PREFERRED_VERSION_linux-libc-headers = "${LINUX_LIBC_HEADERS_VERSION}"
PREFERRED_VERSION_linux-libc-headers-native = "${LINUX_LIBC_HEADERS_VERSION}"
PREFERRED_VERSION_linux-libc-headers-nativesdk = "${LINUX_LIBC_HEADERS_VERSION}"
PREFERRED_VERSION_linux-cocon486 = "${LINUX_LIBC_HEADERS_VERSION}"

KERNEL_IMAGETYPE = "bzImage"

MACHINE_EXTRA_RRECOMMENDS = " kernel-modules"
TARGET_VENDOR = "-pc"
MACHINE_FEATURES = "nfs ipv4 ipv6 wifi alsa ext2 vfat pcmcia usbhost pci largefile nls xattr x86 x11 argp opengl udev pcbios"

udevdir = "/dev"

# Kernel
PREFERRED_PROVIDER_virtual/kernel = "linux-cocon486"
KERNEL_IMAGETYPE = "bzImage"
#LINUX_LIBC_HEADERS_VERSION = "4.1.17"
```

## meta-coconport/coconx64/conf/machine/coconx64.conf
```bitbake
# Copyright (C) 2007, Stelios Koroneos - Digital OPSiS, All Rights Reserved
# Released under the MIT license (see packages/COPYING)
#@TYPE: Machine
#@NAME: coconx64
#@DESCRIPTION: Machine configuration for a Linux running on x86 compatible machines

DEFAULTTUNE = "genericx64-64"
require conf/machine/include/tune-genericx64.inc

TARGET_ARCH = "x86_64"
TUNE_ARCH = "x86_64"

PREFERRED_PROVIDER_virtual/kernel = "linux-coconx64"
PREFERRED_PROVIDER_virtual/xserver = "xserver-xorg"

PREFERRED_VERSION_linux-libc-headers = "${LINUX_LIBC_HEADERS_VERSION}"
PREFERRED_VERSION_linux-libc-headers-native = "${LINUX_LIBC_HEADERS_VERSION}"
PREFERRED_VERSION_linux-libc-headers-nativesdk = "${LINUX_LIBC_HEADERS_VERSION}"
PREFERRED_VERSION_linux = "${LINUX_LIBC_HEADERS_VERSION}"

KERNEL_IMAGETYPE = "bzImage"

MACHINE_EXTRA_RRECOMMENDS = " kernel-modules"
#TARGET_VENDOR = "-pc"
MACHINE_FEATURES = "nfs ipv4 ipv6 wifi alsa ext2 vfat pcmcia usbhost pci largefile nls xattr x86 x11 argp opengl udev pcbios"

udevdir = "/dev"

# Kernel
PREFERRED_PROVIDER_virtual/kernel = "linux"
KERNEL_IMAGETYPE = "bzImage"
#LINUX_LIBC_HEADERS_VERSION = "4.1.17"


MACHINE_FEATURES += "x86"

MACHINE_ESSENTIAL_EXTRA_RDEPENDS += "v86d"
```

## meta-coconport/coconx64/conf/machine/include/tune-genericx64.inc
```bitbake
DEFAULTTUNE ?= "genericx64-64"

include conf/machine/include/x86-base.inc
require conf/machine/include/tune-core2.inc

TUNEVALID[genericx64] = "Generic older x64 cpu tunes"
TUNE_CCARGS .= "${@bb.utils.contains("TUNE_FEATURES", "genericx64", " -march=x86-64 -mtune=generic -mfpmath=sse ", "", d)}"

AVAILTUNES += "genericx64-64"
TUNE_FEATURES_tune-genericx64-64 = "${TUNE_FEATURES_tune-x86-64} genericx64"
BASE_LIB_tune-genericx64-64 = "lib64"
TUNE_PKGARCH_tune-genericx64-64 = "genericx64-64"
PACKAGE_EXTRA_ARCHS_tune-genericx64-64 = "${PACKAGE_EXTRA_ARCHS_tune-x86-64} genericx64-64"
```

## meta-coconport/msi-primo81/conf/layer.conf
```bitbake
# We have a conf and classes directory, append to BBPATH
BBPATH .= ":${LAYERDIR}"

# We have a recipes directory, add to BBFILES
BBFILES += "${LAYERDIR}/recipes*/*/*.bb ${LAYERDIR}/recipes*/*/*.bbappend"

BBFILE_COLLECTIONS += "cocon-layer"
BBFILE_PATTERN_cocon-layer := "^${LAYERDIR}/"
BBFILE_PRIORITY_cocon-layer = "7"
```

## meta-coconport/msi-primo81/conf/machine/msi-primo81.conf
```bitbake
#@TYPE: Machine
#@NAME: MSI Primo 81
#@DESCRIPTION: Machine configuration for the MSI Primo 81 Tablet with A31 CPU
#http://linux-sunxi.org/MSI_Primo81

require conf/machine/include/sun6i.inc

KERNEL_DEVICETREE = "sun6i-a31s-primo81.dtb"
UBOOT_MACHINE = "MSI_Primo81_config"
```
